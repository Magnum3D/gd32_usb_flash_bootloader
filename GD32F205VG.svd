# GD32F20x_CL register map
File version: 1.0
GD32F20x ARM 32-bit Cortex-M3 Microcontroller based device
CPU: CM3 r2p1, little endian, no MPU, no FPU, 4 interrupt priority bits
Registers are 32-bit, read-write, reset 0x0 unless marked. A register's access mark holds for its fields unless they carry their own. Offsets are from the block's base; lines under a group give offsets from that group; [hi:lo] are bit positions; {n}, {i} and the like mark numbered series; 'fields as' and 'values as' point back to an identical list; <NAME> marks a mode.

## Memory map
0x40000000 TIMER1 size 0x400 — General-purpose-timers
0x40000400 TIMER2 size 0x400
0x40000800 TIMER3 size 0x400
0x40000C00 TIMER4 size 0x400
0x40001000 TIMER5 size 0x400 — Basic-timers
0x40001400 TIMER6 size 0x400
0x40001800 TIMER11 size 0x400
0x40001C00 TIMER12 size 0x400
0x40002000 TIMER13 size 0x400
0x40002800 RTC size 0x400 — Real-time clock
0x40002C00 WWDGT size 0x400 — Window watchdog timer
0x40003000 FWDGT size 0x400 — free watchdog timer
0x40003800 SPI1 size 0x400
0x40003C00 SPI2 size 0x400
0x40004400 USART1 size 0x400
0x40004800 USART2 size 0x400
0x40004C00 UART3 size 0x400 — Universal asynchronous receiver transmitter
0x40005000 UART4 size 0x400
0x40005400 I2C0 size 0x400 — Inter integrated circuit
0x40005800 I2C1 size 0x400
0x40006400 CAN0 size 0x400 — Controller area network
0x40006800 CAN1 size 0x400
0x40006C00 BKP size 0x400 — Backup registers
0x40007000 PMU size 0x400 — Power management unit
0x40007400 DAC size 0x400 — Digital to analog converter
0x40007800 UART6 size 0x400
0x40007C00 UART7 size 0x400
0x4000C000 I2C2 size 0x400
0x40010000 AFIO size 0x400 — Alternate-function I/Os
0x40010400 EXTI size 0x400 — External interrupt/event controller
0x40010800 GPIOA size 0x400 — General-purpose I/Os
0x40010C00 GPIOB size 0x400
0x40011000 GPIOC size 0x400
0x40011400 GPIOD size 0x400
0x40011800 GPIOE size 0x400
0x40011C00 GPIOF size 0x400
0x40012000 GPIOG size 0x400
0x40012400 ADC0 size 0x400 — Analog to digital converter
0x40012800 ADC1 size 0x400 — Analog to digital converter
0x40012C00 TIMER0 size 0x400 — Advanced timer
0x40013000 SPI0 size 0x400 — Serial peripheral interface
0x40013400 TIMER7 size 0x400
0x40013800 USART0 size 0x400 — Universal synchronous asynchronous receiver transmitter
0x40013C00 ADC2 size 0x400
0x40014C00 TIMER8 size 0x400 — General-purpose-timers
0x40015000 TIMER9 size 0x400 — General-purpose-timers
0x40015400 TIMER10 size 0x400
0x40016800 TLI size 0x400 — TFT-LCD interface
0x40017000 USART5 size 0x400
0x40017400 GPIOH size 0x400
0x40017800 GPIOI size 0x400
0x40018000 SDIO size 0x400 — Secure digital input/output interface
0x40020000 DMA0 size 0x400 — DMA controller
0x40020400 DMA1 size 0x400 — DMA controller
0x40021000 RCU size 0x400 — Reset and clock unit
0x40022000 FMC size 0x400
0x40023000 CRC size 0x400 — CRC calculation unit
0x40028000 ENET_MAC size 0x1100 — Ethernet: media access control
0x40028100 ENET_MSC size 0x400 — Ethernet: MAC statistics counters
0x40028700 ENET_PTP size 0x400 — Ethernet: Precision time protocol
0x40029000 ENET_DMA size 0x60 — Ethernet: DMA controller operation
0x50000000 USBFS_GLOBAL size 0x400 — USB full speed global registers
0x50000400 USBFS_HOST size 0x400 — USB on the go full speed host
0x50000800 USBFS_DEVICE size 0x400 — USB on the go full speed device
0x50000E00 USBFS_PWRCLK size 0x100 — USB on the go full speed
0x50050000 DCI size 0x400 — Digital Camera Interface
0x50060000 CAU size 0x400 — Cryptographic acceleration unit
0x50060400 HAU size 0x400 — HAU acceleration unit
0x50060800 TRNG size 0x400 — Ture random number generator
0xA0000000 EXMC size 0x1000 — External memory controller
0xE000E000 NVIC size 0x1001 — Nested Vectored Interrupt Controller
0xE0042000 DBG size 0x400 — Debug support

## Interrupts
0 WWDGT
2 Tamper (BKP)
3 RTC
4 FMC
5 RCU
6 EXTI_Line0 (EXTI)
7 EXTI_Line1 (EXTI)
8 EXTI_Line2 (EXTI)
9 EXTI_Line3 (EXTI)
10 EXTI_Line4 (EXTI)
11 DMA0_Channel0 (DMA0)
12 DMA0_Channel1 (DMA0)
13 DMA0_Channel2 (DMA0)
14 DMA0_Channel3 (DMA0)
15 DMA0_Channel4 (DMA0)
16 DMA0_Channel5 (DMA0)
17 DMA0_Channel6 (DMA0)
18 ADC0_1 (ADC0, ADC1)
19 CAN0_TX (CAN0)
20 CAN0_RX0 (CAN0)
21 CAN0_RX1 (CAN0)
22 CAN0_EWMC (CAN0)
23 EXTI_line5_9 (EXTI)
24 TIMER0_BRK_TIMER8 (TIMER0, TIMER8)
25 TIMER0_UP_TIMER9 (TIMER0, TIMER9)
26 TIMER0_TRG_CMT_TIMER10 (TIMER0, TIMER10)
27 TIMER0_Channel (TIMER0)
28 TIMER1
29 TIMER2
30 TIMER3
31 I2C0_EV (I2C0)
32 I2C0_ER (I2C0)
33 I2C1_EV (I2C1)
34 I2C1_ER (I2C1)
35 SPI0
36 SPI1
37 USART0
38 USART1
39 USART2
40 EXTI_line10_15 (EXTI)
41 RTC_Alarm (RTC)
42 USBFS_WKUP (USBFS_GLOBAL)
43 TIMER7_BRK_TIMER11 (TIMER7, TIMER11)
44 TIMER7_UP_TIMER12 (TIMER7, TIMER12)
45 TIMER7_TRG_CMT_TIMER13 (TIMER7, TIMER13)
46 TIMER7_Channel (TIMER7)
47 ADC2
48 EXMC
49 SDIO
50 TIMER4
51 SPI2
52 UART3
53 UART4
54 TIMER5
55 TIMER6
56 DMA1_Channel0 (DMA1)
57 DMA1_Channel1 (DMA1)
58 DMA1_Channel2 (DMA1)
59 DMA1_Channel3 (DMA1)
60 DMA1_Channel4 (DMA1)
61 ENET (ENET_MAC)
62 ENET_WKUP (ENET_MAC)
63 CAN1_TX (CAN1)
64 CAN1_RX0 (CAN1)
65 CAN1_RX1 (CAN1)
66 CAN1_EWMC (CAN1)
67 USBFS (USBFS_GLOBAL)
71 USART5
72 I2C2_EV (I2C2)
73 I2C2_ER (I2C2)
78 DCI
79 CAU
80 HAU_TRNG (HAU, TRNG)
82 UART6
83 UART7
88 TLI
89 TLI_ER (TLI)
